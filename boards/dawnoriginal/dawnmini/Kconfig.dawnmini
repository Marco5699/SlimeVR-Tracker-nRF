## boards/dawnoriginal/dawnmini/Kconfig.dawnmini
```kconfig
# Copyright (c) 2026
# SPDX-License-Identifier: Apache-2.0

config BOARD_DAWNMINI
	select SOC_NRF52833_QDAA
```

## boards/dawnoriginal/dawnmini/board.yml
```yaml
# Copyright (c) 2026
# SPDX-License-Identifier: Apache-2.0

board:
  name: dawnmini
  vendor: dawnoriginal
  socs:
    - name: nrf52833
```
